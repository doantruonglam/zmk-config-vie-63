## config/boards/arm/dis30/Kconfig.board
```kconfig
# Zaphod board configuration

# Copyright (c) 2020 Pete Johanson
# SPDX-License-Identifier: MIT

config BOARD_VIE63
	bool "Vie63"
	depends on SOC_NRF52840_QIAA
```

## config/boards/arm/dis30/vie63_defconfig
```kconfig
# SPDX-License-Identifier: MIT

CONFIG_SOC_SERIES_NRF52X=y
CONFIG_SOC_NRF52840_QIAA=y
CONFIG_BOARD_VIE63=y

# Enable MPU
CONFIG_ARM_MPU=y

# enable GPIO
CONFIG_GPIO=y

# Enable deep sleep
# CONFIG_ZMK_SLEEP=y
# CONFIG_ZMK_IDLE_SLEEP_TIMEOUT=1800000


CONFIG_USE_DT_CODE_PARTITION=y

CONFIG_MPU_ALLOW_FLASH_WRITE=y
CONFIG_NVS=y
CONFIG_SETTINGS_NVS=y
CONFIG_FLASH=y
CONFIG_FLASH_PAGE_LAYOUT=y
CONFIG_FLASH_MAP=y

# Uncomment to enable encoder
CONFIG_EC11=y
CONFIG_EC11_TRIGGER_GLOBAL_THREAD=y

# Use the STRIP config specific to the LEDs you're using
CONFIG_ZMK_RGB_UNDERGLOW=y
CONFIG_WS2812_STRIP=y
CONFIG_ZMK_RGB_UNDERGLOW_HUE_START=160
CONFIG_ZMK_RGB_UNDERGLOW_EFF_START=3
CONFIG_ZMK_EXT_POWER=y
CONFIG_ZMK_RGB_UNDERGLOW_EXT_POWER=y
CONFIG_ZMK_RGB_UNDERGLOW_ON_START=y

# Uncomment lines below to oled
CONFIG_DISPLAY=y
CONFIG_ZMK_DISPLAY=y
CONFIG_ZMK_WIDGET_WPM_STATUS=y
CONFIG_ZMK_WIDGET_BATTERY_STATUS_SHOW_PERCENTAGE=y

# Config display
CONFIG_LV_Z_BITS_PER_PIXEL=1
CONFIG_LV_COLOR_DEPTH_1=y
CONFIG_LV_DPI_DEF=148
CONFIG_LV_Z_VDB_SIZE=64
CONFIG_LV_USE_THEME_MONO=y
CONFIG_LV_COLOR_CHROMA_KEY_HEX=0x00FF00

# New config for PINCTRL
CONFIG_PINCTRL=y

# Build UF2
CONFIG_BUILD_OUTPUT_UF2=y
```

## config/boards/arm/vie63/Kconfig.defconfig
```kconfig
# Copyright (c) 2020 Pete Johanson
# SPDX-License-Identifier: MIT

if BOARD_VIE63

config BOARD
	default "vie63"

config ZMK_KEYBOARD_NAME
	default "VIE60 Ble"

if USB

config USB_NRFX
	default y

config USB_DEVICE_STACK
	default y

endif # USB

config BT_CTLR
	default BT

config ZMK_BLE
	default y

config ZMK_USB
	default y

config ZMK_EXT_POWER
	default y

config ZMK_BATTERY_VOLTAGE_DIVIDER
	default y

if ZMK_DISPLAY

config I2C
  default y

config SSD1306
  default y

config SSD1306_REVERSE_MODE
  default y

config ZMK_DISPLAY_BLANK_ON_IDLE
  default y

endif # ZMK_DISPLAY

endif # BOARD_VIE63
```
